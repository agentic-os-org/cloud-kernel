## Documentation/devicetree/bindings/iio/adc/phytium,adc.yaml
```yaml
# SPDX-License-Identifier: (GPL-2.0-only OR BSD-2-Clause)
%YAML 1.2
---
title: Phytium Analog To Digital Converters Device Tree Bindings

description: |
  This device is a 10-bit converter for 8 voltage channels.
  All inputs are single ended.

properties:
  compatible:
    items:
      - description: Should be "phytium,adc"

  reg:
    items:
      - description: memory window mapping address and length

  interrupts:
    items:
      - description: Interrupt for the ADC control interface.

  clocks:
    items:
      - description: Input clock used to derive the sample clock.

  #address-cells:
    items:
      - description: Should be <1> (settings for the subnodes).

  #size-cells:
    items:
      - description: Should be <0> (settings for the subnodes).

required:
  - compatible
  - reg
  - interrupts
  - clock
  - #address-cells
  - #size-cells

Required subnodes:
  - The ADC channels are configured as subnodes of the ADC.

Required channel node properties:
  - reg: should contain the hardware channel number.

examples:
  - |
    adc0: adc@2807b000 {
        compatible = "phytium,adc";
        reg = <0x0 0x2807b000 0x0 0x1000>;
        interrupts = <GIC_SPI 232 IRQ_TYPE_LEVEL_HIGH>;
        clocks = <&sysclk_48mhz>;

        #address-cells = <1>;
        ##size-cells = <0>;

        channel@0 {
            reg = <0>;
        };
        channel@1 {
            reg = <1>;
        };
        channel@2 {
            reg = <2>;
        };
        channel@3 {
            reg = <3>;
        };
        channel@4 {
            reg = <4>;
        };
        channel@5 {
            reg = <5>;
        };
        channel@6 {
            reg = <6>;
        };
        channel@7 {
            reg = <7>;
        };
    };
```

## Documentation/devicetree/bindings/ipmi/phytium,bt-bmc.txt
```
Phytium BT (Block Transfer) IPMI interface

The Phytium E-series SOCs can be used in BMC which may
have a BT interface used to perform in-band IPMI communication
with their host.

Required properties:

- compatible : should be one of
               "phytium,bt-bmc"
- reg: physical address and size of the registers
- interrupts: interrupt generated by the BT interface.

Example:

	bt: bt@250 {
		compatible = "phytium,bt-bmc";
		reg = <0x250 0x1c>;
		interrupts = <GIC_SPI 88 IRQ_TYPE_LEVEL_HIGH>;
	};
```

## Documentation/devicetree/bindings/ipmi/phytium,kcs-bmc.txt
```
Phytium KCS (Keyboard Controller Style) IPMI interface

The Phytium E-series SOC can be used in BMC which
have the KCS interface to perform in-band IPMI communication
with their host.

Required properties:
- compatible : should be one of
               "phytium,kcs-bmc"
- reg        : physical address and size of the registers
- interrupts : interrupt generated by the controller
- kcs_chan   : The LPC channel number in the controller
- kcs_addr   : The host CPU IO map address

Example:

    kcs0: kcs@24 {
        compatible = "phytium,kcs-bmc";
        reg = <0x24 0x1>, <0x30 0x1>, <0x3c 0x1>;
        interrupts = <GIC_SPI 88 IRQ_TYPE_LEVEL_HIGH>;
        kcs_chan = <1>;
        kcs_addr = <0xca0>;
    };
```

## Documentation/devicetree/bindings/media/phytium-jpeg.txt
```
Phytium JPEG Encoder driver

Required properties:
- compatible : Should be "phytium,jpeg"
- reg : Offset and length of the register set of this block

Example:
        jpeg@32b32000 {
		compatible = "phytium,e2000-jpeg";
		reg = <0x0 0x32b32000 0 0x1000>;
	};
```

## Documentation/devicetree/bindings/mtd/phytium-nand.txt
```
Phytium NAND

Required properties:
- compatible : Should be "phytium,nfc"
- reg : Offset and length of the register set of this block

Example:

	nand0: nand@28002000 {
		compatible = "phytium,nfc";
		reg = <0x0 0x28002000 0x0 0x1000>;
	};
```

## Documentation/devicetree/bindings/rng/phytium-rng.yaml
```yaml
# SPDX-License-Identifier: GPL-2.0
%YAML 1.2
---
$id: http://devicetree.org/schemas/rng/phytium-rng.yaml#
$schema: http://devicetree.org/meta-schemas/core.yaml#

title: Phytium Random Number Generator

maintainers:
      - chen Baozi <chenbaozi@phytium.com.cn>
properties:
  compatible:
    const: phytium,rng
reg:
    minItems: 1
    items:
      - desceiption:Offset and length of the register set of this block

required:
  - compatible
  - reg

additionalProperties: false
examples:
  - |
   rng@0x31a06000 {
       compatible = "phytium,rng";
       reg = <0x0 0x31a06000 0x0 0x1000>;
     };
```

## Documentation/devicetree/bindings/sound/phytium,hda.yaml
```yaml
# SPDX-License-Identifier: (GPL-2.0-only OR BSD-2-Clause)
%YAML 1.2
---
title: Phytium HDA Controller Device Tree Bindings

description: |
  The HDA bus (High Definition Audio sound bus) is a serial link for digital
  audio data transfer between devices in the system.

maintainers:
  - Tian Wei <tianwei@phytium.com.cn>

properties:
  $nodename:
    pattern: "phytium,hda"

  compatible:
    oneOf:
      - const: phytium,hda
      - items:
          - enum:
              - phytium,hda
          - const: phytium,hda

  reg:
    minItems: 4

  interrupts:
    minItems: 3

  clocks:
    minItems: 1

  clock-names:
    minItems: 1

required:
  - compatible
  - reg
  - interrupts
  - clocks
  - clock-names

examples:
  - |

    hda@28206000 {
	compatible = "phytium,hda";
	reg = <0 0x28206000 0x0 0x1000>;
	interrupts = <GIC_SPI 23 IRQ_TYPE_LEVEL_HIGH>;
	clocks = <&sysclk_48mhz>;
	clock-names = "phytium_hda_clk";
    };
```

## Documentation/devicetree/bindings/usb/phytium,usb2.yaml
```yaml
# SPDX-License-Identifier: (GPL-2.0-only OR BSD-2-Clause)
%YAML 1.2
---
examples:
  - |
    usb2_0: usb2@31800000 {
        compatible = "phytium,usb2";
        reg = <0x0 0x31800000 0x0 0x80000>,
              <0x0 0x31990000 0x0 0x10000>;
        interrupts = <GIC_SPI 32 IRQ_TYPE_LEVEL_HIGH>;
        status = "disabled";
    };
```

## Documentation/devicetree/bindings/w1/phytium,w1.yaml
```yaml
# SPDX-License-Identifier: (GPL-2.0-only OR BSD-2-Clause)
%YAML 1.2
---
$id: http://devicetree.org/schemas/sound/nvidia,tegra210-i2s.yaml#
$schema: http://devicetree.org/meta-schemas/core.yaml#

title: Phytium 1-Wire Bus Master Controller Device Tree Bindings

properties:
  compatible:
    items:
      - description: should be "phytium,w1"

  reg:
    items:
      - description: Address and length of the register set for the device

  interrupts:
    items:
      - description: interrupt line.

required:
  - compatible
  - reg
  - interrupts

examples:
  - |

    onewire0: onewire@2803f000 {
        compatible = "phytium,w1";
        reg = <0x0 0x2803f000 0x0 0x1000>;
        interrupts = <GIC_SPI 166 IRQ_TYPE_LEVEL_HIGH>;
    };
```
