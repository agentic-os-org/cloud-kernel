## Documentation/devicetree/bindings/riscv/ntrace/xuantie_ntrace,encoder-controller.yaml
```yaml
# SPDX-License-Identifier: GPL-2.0-only OR BSD-2-Clause
%YAML 1.2
---
$id: http://devicetree.org/schemas/riscv/ntrace/xuantie_ntrace,encoder-controller.yaml#
$schema: http://devicetree.org/meta-schemas/core.yaml#

title: RISC-V XUANTIE N-Trace encoder controller

maintainers:
  - Jiangshuai Li <jiangshuai_li@linux.alibaba.com>
  - Chen Pei <cp0613@linux.alibaba.com>

description: |
  One node describes the instruction trace encoder of a single hart. The
  encoder packs the executed-branch trace stream into N-Trace messages and
  pushes them to the downstream component listed in its output_port.

  Encoder registers are accessed through the memory region given in reg.

properties:
  compatible:
    const: xuantie_ntrace,encoder-controller

  reg:
    maxItems: 1
    description:
      Encoder register region.

  cpu:
    $ref: /schemas/types.yaml#/definitions/uint32
    description:
      Linux CPU number this encoder belongs to. The driver derives the hart
      id from it, so the property is mandatory.

  trace_encoder_format:
    $ref: /schemas/types.yaml#/definitions/uint32
    minimum: 0
    maximum: 7
    default: 1
    description:
      Trace encoding format. 1 selects N-Trace, 0 ARM E-trace style encoding,
      7 vendor defined. Only N-Trace is decoded by the perf tool.

  trace_encoder_inst_mode:
    $ref: /schemas/types.yaml#/definitions/uint32
    minimum: 0
    maximum: 7
    default: 6
    description:
      Instruction tracing level. 3 selects branch trace, 6 branch history
      trace, 0 disables instruction trace, 7 vendor defined.

  trace_encoder_context:
    $ref: /schemas/types.yaml#/definitions/string
    enum: ["true", "false"]
    default: "true"
    description:
      Send context (privilege mode changes) messages. The driver compares the
      string against "true".

  trace_encoder_inst_stall_enable:
    $ref: /schemas/types.yaml#/definitions/string
    enum: ["true", "false"]
    default: "true"
    description:
      Emit stall messages when the hart stops retiring instructions.

  trace_encoder_inhibit_src:
    $ref: /schemas/types.yaml#/definitions/string
    enum: ["true", "false"]
    default: "false"
    description:
      Suppress the source identifier in the trace stream. When "false" the
      src id is emitted.

  trace_encoder_src_id:
    $ref: /schemas/types.yaml#/definitions/uint32
    description:
      Source identifier written into the trace stream. Defaults to the value
      of cpu.

  trace_encoder_inst_sync_mode:
    $ref: /schemas/types.yaml#/definitions/uint32
    enum: [0, 1, 2, 3]
    default: 0
    description:
      Periodic synchronisation mode. 0 no sync packets, 1 counted trace
      messages, 2 counted hart clock cycles, 3 counted 16-bit half-words.

  trace_encoder_inst_sync_max:
    $ref: /schemas/types.yaml#/definitions/uint32
    description:
      Period of the sync packets selected by trace_encoder_inst_sync_mode.
      Mandatory (probe fails) whenever trace_encoder_inst_sync_mode is not 0.

  trace_encoder_inst_trigger_enable:
    $ref: /schemas/types.yaml#/definitions/string
    enum: ["true", "false"]
    default: "true"
    description:
      Allow the encoder to be enabled and disabled by a hardware trigger.

  trace_timestamp_enable:
    $ref: /schemas/types.yaml#/definitions/string
    enum: ["true", "false"]
    default: "false"
    description:
      Emit timestamp messages.

  trace_timestamp_mode:
    $ref: /schemas/types.yaml#/definitions/uint32
    minimum: 0
    maximum: 7
    description:
      Timestamp source. 0 none, 1 external signal, 2 internal system counter,
      3 internal core counter, 4 shared counter, 7 vendor specific. Mandatory
      (probe fails) whenever trace_timestamp_enable is "true".

  trace_timestamp_prescale:
    $ref: /schemas/types.yaml#/definitions/uint32
    default: 0
    description:
      Prescaler applied to the timestamp counter before it is encoded.

  output_port:
    type: object
    description:
      Container of the encoder output ports. Each child node describes one
      port and must carry an "endpoint" phandle pointing at the downstream
      funnel or sink node. The referenced node must provide a 4-element reg
      property, from which the driver builds the 64-bit register base
      address (reg[0] is the high half, reg[1] the low half).

    patternProperties:
      ".*":
        type: object
        properties:
          endpoint:
            $ref: /schemas/types.yaml#/definitions/phandle
        required:
          - endpoint
        additionalProperties: false

  '#address-cells':
    const: 1

  '#size-cells':
    const: 0

required:
  - compatible
  - reg
  - cpu
  - output_port

additionalProperties: false

example:
  - |
    encoder0: encoder@2020000000 {
        compatible = "xuantie_ntrace,encoder-controller";
        reg = <0x20 0x20000000 0x0 0x1000>;
        cpu = <0>;
        trace_encoder_format = <1>;
        trace_encoder_inst_mode = <6>;
        trace_encoder_context = "true";
        trace_encoder_inst_stall_enable = "true";
        trace_encoder_inhibit_src = "false";
        trace_encoder_src_id = <0>;
        trace_encoder_inst_sync_mode = <0>;
        trace_encoder_inst_trigger_enable = "true";
        trace_timestamp_enable = "true";
        trace_timestamp_mode = <2>;
        trace_timestamp_prescale = <0>;
        #address-cells = <1>;
        #size-cells = <0>;

        output_port {
            encoder_0_1 {
                endpoint = <&funnel1>;
            };
        };
    };

...
```

## Documentation/devicetree/bindings/riscv/ntrace/xuantie_ntrace,funnel-controller.yaml
```yaml
# SPDX-License-Identifier: GPL-2.0-only OR BSD-2-Clause
%YAML 1.2
---
$id: http://devicetree.org/schemas/riscv/ntrace/xuantie_ntrace,funnel-controller.yaml#
$schema: http://devicetree.org/meta-schemas/core.yaml#

title: RISC-V XUANTIE N-Trace funnel controller

maintainers:
  - Jiangshuai Li <jiangshuai_li@linux.alibaba.com>
  - Chen Pei <cp0613@linux.alibaba.com>

description: |
  The funnel merges the trace streams of several upstream components into one
  downstream component. Each input port is enabled individually, so the
  encoder and funnel nodes feeding this funnel must list it in their
  output_port.

  Funnel registers are accessed through the memory region given in reg.

properties:
  compatible:
    const: xuantie_ntrace,funnel-controller

  reg:
    maxItems: 1
    description:
      Funnel register region.

  level:
    $ref: /schemas/types.yaml#/definitions/uint32
    enum: [1, 2]
    default: 1
    description:
      Funnel depth in the trace tree. Level 1 collects encoder streams, level
      2 collects level 1 funnel streams.

  input_port:
    type: object
    description:
      Container of the funnel input ports. Each child node describes one port
      and must carry an "endpoint" phandle pointing at the upstream component
      node. The referenced node must provide a 4-element reg property, from
      which the driver builds the 64-bit register base address (reg[0] is the
      high half, reg[1] the low half).

    patternProperties:
      ".*":
        type: object
        properties:
          endpoint:
            $ref: /schemas/types.yaml#/definitions/phandle
        required:
          - endpoint
        additionalProperties: false

  output_port:
    type: object
    description:
      Container of the funnel output ports, using the same port description as
      input_port.

    patternProperties:
      ".*":
        type: object
        properties:
          endpoint:
            $ref: /schemas/types.yaml#/definitions/phandle
        required:
          - endpoint
        additionalProperties: false

  '#address-cells':
    const: 1

  '#size-cells':
    const: 0

required:
  - compatible
  - reg
  - input_port
  - output_port

additionalProperties: false

example:
  - |
    funnel1: funnel@2020001000 {
        compatible = "xuantie_ntrace,funnel-controller";
        reg = <0x20 0x20001000 0x0 0x1000>;
        level = <1>;
        #address-cells = <1>;
        #size-cells = <0>;

        input_port {
            funnel1_in_0 {
                endpoint = <&encoder0>;
            };
            funnel1_in_1 {
                endpoint = <&encoder1>;
            };
        };

        output_port {
            funnel1_out_0 {
                endpoint = <&sink0>;
            };
        };
    };

...
```

## Documentation/devicetree/bindings/riscv/ntrace/xuantie_ntrace,sink-controller.yaml
```yaml
# SPDX-License-Identifier: GPL-2.0-only OR BSD-2-Clause
%YAML 1.2
---
$id: http://devicetree.org/schemas/riscv/ntrace/xuantie_ntrace,sink-controller.yaml#
$schema: http://devicetree.org/meta-schemas/core.yaml#

title: RISC-V XUANTIE N-Trace sink controller

maintainers:
  - Jiangshuai Li <jiangshuai_li@linux.alibaba.com>
  - Chen Pei <cp0613@linux.alibaba.com>

description: |
  The sink collects the merged trace stream and writes it either into a
  reserved memory region (memory-region) or into a DMA coherent buffer
  allocated by the driver (iommu-trace-buffer-size). The perf auxtrace
  back-end reads the buffer through the sink registers given in reg.

  Sink registers are accessed through the memory region given in reg.

properties:
  compatible:
    const: xuantie_ntrace,sink-controller

  reg:
    maxItems: 1
    description:
      Sink register region.

  working_mode:
    $ref: /schemas/types.yaml#/definitions/string
    description:
      Sink operating mode as reported by the driver at probe time. The driver
      only records and prints this string, defaulting to
      "circulating buffer", which is the only mode the hardware currently
      supports.

  format:
    $ref: /schemas/types.yaml#/definitions/string
    description:
      Data format stored in the trace buffer. The driver only records and
      prints this string, defaulting to "original" (raw N-Trace message
      stream).

  memory-region:
    $ref: /schemas/types.yaml#/definitions/phandle
    description:
      Phandle of a reserved-memory node holding the trace buffer. When
      absent, the driver allocates a DMA coherent buffer instead.

  iommu-trace-buffer-size:
    $ref: /schemas/types.yaml#/definitions/uint32
    description:
      Size in bytes of the DMA coherent trace buffer. Only read when
      memory-region is absent; a value of 0 selects the driver default.

  input_port:
    type: object
    description:
      Container of the sink input ports. Each child node describes one port
      and must carry an "endpoint" phandle pointing at the upstream funnel
      node. The referenced node must provide a 4-element reg property, from
      which the driver builds the 64-bit register base address (reg[0] is the
      high half, reg[1] the low half).

    patternProperties:
      ".*":
        type: object
        properties:
          endpoint:
            $ref: /schemas/types.yaml#/definitions/phandle
        required:
          - endpoint
        additionalProperties: false

  '#address-cells':
    const: 1

  '#size-cells':
    const: 0

required:
  - compatible
  - reg
  - input_port

additionalProperties: false

example:
  - |
    sink0: sink@2020002000 {
        compatible = "xuantie_ntrace,sink-controller";
        reg = <0x20 0x20002000 0x0 0x1000>;
        working_mode = "circulating buffer";
        format = "original";
        memory-region = <&ntrace_reserved>;
        #address-cells = <1>;
        #size-cells = <0>;

        input_port {
            sink0_in_0 {
                endpoint = <&funnel1>;
            };
        };
    };

...
```

## drivers/hwtracing/xuantie_ntrace/Kconfig
```kconfig
# SPDX-License-Identifier: GPL-2.0
config XUANTIE_NTRACE
	tristate "XUANTIE NTRACE events"
	depends on PERF_EVENTS && RISCV
	default m
	help
	  xuantie_ntrace is an instruction-level trace component
	  of the CPU. xuantie_ntrace system uses RISC-V Nexus
	  Trace solution.
	  Implement a xuantie_ntrace pmu driver and integrate the
	  trace function into the perf framework so that the trace
	  function can be used through the perf command.
```

## drivers/virt/coco/Kconfig
```kconfig
# SPDX-License-Identifier: GPL-2.0-only
#
# Confidential computing related collateral
#

config TSM_REPORTS
	select CONFIGFS_FS
	tristate "TSP report configfs ABI support"
	help
	  TSM report configfs ABI support

config TSM_MEASUREMENTS
	select CRYPTO_HASH_INFO
	select CRYPTO
	bool

source "drivers/virt/coco/efi_secret/Kconfig"

source "drivers/virt/coco/csv-guest/Kconfig"

source "drivers/virt/coco/tdx-guest/Kconfig"
```

## fs/resctrl/Kconfig
```kconfig
config RESCTRL_FS
	bool "CPU Resource Control Filesystem (resctrl)"
	depends on ARCH_HAS_CPU_RESCTRL
	select KERNFS
	select PROC_CPU_RESCTRL if PROC_FS
	help
	  Some architectures provide hardware facilities to group tasks and
	  monitor and control their usage of memory system resources such as
	  caches and memory bandwidth.  Examples of such facilities include
	  Intel's Resource Director Technology (Intel(R) RDT) and AMD's
	  Platform Quality of Service (AMD QoS).

	  If your system has the necessary support and you want to be able to
	  assign tasks to groups and manipulate the associated resource
	  monitors and controls from userspace, say Y here to get a mountable
	  'resctrl' filesystem that lets you do just that.

	  If nothing mounts or prods the 'resctrl' filesystem, resource
	  controls and monitors are left in a quiescent, permissive state.

	  On architectures where this can be disabled independently, it is
	  safe to say N.

	  See <file:Documentation/filesystems/resctrl.rst> for more information.

config RESCTRL_FS_PSEUDO_LOCK
	bool
	depends on RESCTRL_FS
	help
	  Software mechanism to pin data in a cache portion using
	  micro-architecture specific knowledge.

config RESCTRL_RMID_DEPENDS_ON_CLOSID
	bool
	depends on RESCTRL_FS
	help
	  Enabled by the architecture when the RMID values depend on the CLOSID.
	  This causes the CLOSID allocator to search for CLOSID with clean
	  RMID.

menuconfig RISCV_CBQRI
	bool "RISC-V CBQRI support"
	depends on RISCV && RISCV_ISA_SSQOSID
	select ARCH_HAS_CPU_RESCTRL
	default y
	help
	  Capacity and Bandwidth QoS Register Interface (CBQRI) support for
	  RISC-V cache QoS resources. CBQRI exposes cache capacity
	  allocation through the resctrl filesystem at /sys/fs/resctrl when
	  RESCTRL_FS is also enabled.

if RISCV_CBQRI

config RISCV_CBQRI_CAPACITY
	bool "RISC-V CBQRI cache capacity-allocation controller"
	depends on OF
	help
	  Enable driver for a RISC-V CBQRI capacity controller that
	  governs a CPU cache, matching the "riscv,cbqri-capacity-controller"
	  compatible. The controller's cache phandle gives the cache level and
	  id, which the driver registers as a resctrl cache-allocation resource.

	  Say N unless your device tree describes a CBQRI capacity controller.

endif

config RISCV_CBQRI_RESCTRL_FS
	bool
	default y if RISCV_CBQRI && RESCTRL_FS
```
